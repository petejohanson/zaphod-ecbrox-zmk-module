/*
 * Copyright (c) 2020 The ZMK Contributors
 *
 * SPDX-License-Identifier: MIT
 */

#ifdef ZMK_BEHAVIORS_KEEP_ALL
#undef ZMK_BEHAVIORS_KEEP_ALL
#endif

#define ZMK_BEHAVIORS_KEEP_LT
#define ZMK_BEHAVIORS_KEEP_MT

#include <behaviors.dtsi>
#include <dt-bindings/zmk/keys.h>
#include <dt-bindings/zmk/bt.h>
#include <dt-bindings/zmk/backlight.h>

#define NAV_L 1
#define NUM_L 2
#define MED_L 3
#define FUN_L 4

/ {
    tap_dances {
    	shifty: shift_caps_word {
		compatible = "zmk,behavior-tap-dance";
		display-name = "Shift+";
		#binding-cells = <0>;
		tapping-term-ms = <150>;
		bindings = <&kp LSHFT>, <&caps_word>;
	};
    };

    cond_layers {
        compatible = "zmk,conditional-layers";
	tri {
	    if-layers = <NUM_L NAV_L>;
	    then-layer = <MED_L>;
        };
    };

    macros {
	    ZMK_MACRO1(kp_mac,
		    bindings = <&macro_param_1to1 &kp MACRO_PLACEHOLDER>;
		    )

		    /*
	    ZMK_MACRO1(lt_mac,
		    bindings = <&macro_param_1to2 &mt LEFT_SHIFT MACRO_PLACEHOLDER>;
		    )
	    ZMK_MACRO2(lt_mac2,
		    bindings = <&macro_param_1to1 &macro_param_2to2 &lt MACRO_PLACEHOLDER MACRO_PLACEHOLDER>;
		    )
	    ZMK_MACRO2(lt_mac3,
		    bindings = <&macro_param_1to1 &lt MACRO_PLACEHOLDER LEFT_SHIFT &macro_param_2to2 &bl BL_SET_CMD MACRO_PLACEHOLDER>;
		    )
		    */
    };

    combos {
        compatible = "zmk,combos";

	l_curly_bracket {
	    timeout-ms = <50>;
            key-positions = <2 14>;
            bindings = <&kp LS(LBKT)>;
	    layers = <NUM_L>;
	};

	r_curly_bracket {
	    timeout-ms = <50>;
            key-positions = <4 16>;
            bindings = <&kp LS(RBKT)>;
	    layers = <NUM_L>;
	};

	lbracket {
	    timeout-ms = <50>;
            key-positions = <14 26>;
            bindings = <&kp LBKT>;
	    layers = <NUM_L>;
	};

	rbracket {
	    timeout-ms = <50>;
            key-positions = <16 28>;
            bindings = <&kp RBKT>;
	    layers = <NUM_L>;
	};

	ques_mark_combo {
	    timeout-ms = <50>;
            key-positions = <21 33>;
            bindings = <&kp LS(FSLH)>;
	};

	bslash_combo {
	    timeout-ms = <50>;
            key-positions = <10 22>;
            bindings = <&kp BSLH>;
	};

	fslash_combo {
	    timeout-ms = <50>;
            key-positions = <22 34>;
            bindings = <&kp FSLH>;
	};

	bootloader_combo {
	    timeout-ms = <50>;
            key-positions = <5 6>;
            bindings = <&bootloader>;
	    layers = <MED_L>;
	};

	gui_combo {
	    timeout-ms = <50>;
            key-positions = <16 19>;
            bindings = <&kp LGUI>;
	    layers = <MED_L>;
	};
    };

    keymap {
        compatible = "zmk,keymap";

#ifdef QWERTY_BASE
        qwerty_layer {
            bindings = <
       &kp F1        &kp Q      &kp W      &kp E       &kp R          &kp T         &kp Y            &kp U          &kp I       &kp O      &kp P    &none
       &none        &kp A      &kp S      &kp D       &kp F          &kp G         &kp H            &kp J          &kp K       &kp L      &kp QUOT &none
       &none        &kp Z      &kp X      &kp C       &kp V          &kp B         &kp N            &kp M          &kp COMMA   &kp DOT    &kp SEMI &none
                                          &none   &mo NAV_L      &shifty      &kp SPACE  &mo NUM_L &none
            >;
        };
#else
        colemak_dhm_layer {
		display-name = "Colemak";
            bindings = <
       &none        &kp Q      &kp W      &kp F       &kp P          &kp B         &kp J            &kp L          &kp U       &kp Y      &kp QUOT &none
       &none        &kp A      &kp R      &kp S       &kp T          &kp G         &kp M            &kp N          &kp E       &kp I      &kp O    &none
       &none        &kp Z      &kp X      &kp C       &kp D          &kp V         &kp K            &kp H          &kp COMMA   &kp DOT    &kp SEMI &none     
                                          &studio_unlock       &mo NAV_L      &shifty      &kp SPACE        &mo NUM_L &none
            >;
        };
#endif

        nav_layer {
		display-name = "Nav";
            bindings = <
       &none         &trans     &trans     &trans      &trans          &trans       &kp GRAVE        &kp TAB        &kp GRAVE   &kp BKSP   &kp DEL &none
       &none         &sk LSHFT  &sk LALT   &sk LCTRL   &sk LGUI        &trans       &kp TAB          &kp LARW       &kp DARW    &kp UARW   &kp RARW &none
       &none         &trans     &trans     &trans      &trans          &trans       &trans           &kp HOME       &kp PG_DN   &kp PG_UP  &kp END &none
                                           &none  &trans          &trans       &kp RET          &trans &none
            >;
        };

        num_layer {
		display-name = "Num";
            bindings = <
       &none         &kp ESC   &kp N7     &kp N8      &kp N9          &kp RBKT      &trans        &trans         &trans      &trans     &trans &none
       &none         &kp MINUS  &kp N4     &kp N5      &kp N6          &kp EQUAL     &trans        &sk LGUI       &sk LCTRL      &sk LALT     &sk LSHFT &none
       &none         &kp PLUS  &kp N1     &kp N2      &kp N3          &kp N0        &bt BT_SEL 0  &bt BT_SEL 1   &bt BT_SEL 2 &bt BT_SEL 3 &bt BT_SEL 4 &none
                                          &none   &trans          &trans        &trans        &trans &none
            >;
        };

        media_layer {
		display-name = "Media";
            bindings = <
       &bt BT_CLR    &trans     &trans     &trans      &trans          &trans       &trans           &kp C_PREV     &kp C_VOL_DN     &kp C_VOL_UP &kp C_NEXT &none
       &none         &trans     &trans     &trans      &trans          &trans       &trans           &trans         &trans           &trans       &trans &none
       &none         &trans     &trans     &trans      &trans          &trans       &trans           &trans         &kp C_PLAY_PAUSE &kp C_MUTE       &trans &none
                                           &none  &trans          &trans       &trans           &trans &none
            >;
        };

	extra {
		status = "reserved";
		display-name = "RES1";
	};
    };
};
