## boards/shields/topreviung/Kconfig.shield
```kconfig
config SHIELD_TOPREVIUNG
    def_bool $(shields_list_contains,topreviung)
    select ADC
    select GPIO
```

## boards/shields/zaphod_ecbrox/Kconfig.defconfig
```kconfig
if SHIELD_ZAPHOD_ECBROX

config ZMK_KEYBOARD_NAME
    default "Zaphod ECBrox"

endif
```

## boards/shields/zaphod_ecbrox/Kconfig.shield
```kconfig
config SHIELD_ZAPHOD_ECBROX
    def_bool $(shields_list_contains,zaphod_ecbrox)
    select ADC
    select GPIO
```

## boards/shields/zaphod_ecbrox/boards/xiao_ble.conf
```kconfig
CONFIG_ZMK_KSCAN_EC_MATRIX_FAKE_OPEN_DRAIN=y
CONFIG_ZMK_SLEEP=y
CONFIG_SLEEP_AWAKE_TRIGGER=n
CONFIG_ZMK_PM_SOFT_OFF=y
```
